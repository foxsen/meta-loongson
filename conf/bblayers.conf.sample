## conf/bblayers.conf.sample
```bitbake
# POKY_BBLAYERS_CONF_VERSION is increased each time build/conf/bblayers.conf
# changes incompatibly
POKY_BBLAYERS_CONF_VERSION = "2"

BBPATH = "${TOPDIR}"
BBFILES ?= ""

BBLAYERS ?= " \
  /home/foxsen/software/poky/meta \
  /home/foxsen/software/poky/meta-poky \
  /home/foxsen/software/poky/meta-yocto-bsp \
  /home/foxsen/software/poky/meta-loongson \
  "
```

## conf/layer.conf
```bitbake
# We have a conf and classes directory, add to BBPATH
BBPATH .= ":${LAYERDIR}"

# We have recipes-* directories, add to BBFILES
BBFILES += "${LAYERDIR}/recipes-*/*/*.bb ${LAYERDIR}/recipes-*/*/*.bbappend"

BBFILE_COLLECTIONS += "loongson"
BBFILE_PATTERN_loongson = "^${LAYERDIR}/"
BBFILE_PRIORITY_loongson = "1"

# This should only be incremented on significant changes that will
# cause compatibility issues with other layers
LAYERVERSION_loongson = "1"

LAYERDEPENDS_loongson = "core"

LAYERSERIES_COMPAT_loongson = "kirkstone langdale"

QEMUVERSION = "7.2.0-rc1"
PREFERRED_VERSION_qemu-system-native = "7.2.0-rc1"
```
